 / {
        huawei_fac_info {
                  compatible = "huawei,hw_fac_info";
                  fac,product_name = "HUAWEI B199";
                  fac,hardware_ver = "HS1G750M_VB";
                  fac,software_ver = "MSM8x26_G750_C00_vb";
                  status = "ok";
        };
};
